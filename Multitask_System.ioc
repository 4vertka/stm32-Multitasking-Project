# file: Multitask_System.ioc
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CORTEX_M7.default_mode_Activation=1
FREERTOS.Queues01=TemperatureQueue,8,uint8_t,0,Dynamic,NULL,NULL
FREERTOS.Tasks01=ReadSensor,24,128,ReadSensorTask,Default,NULL,Dynamic,NULL,NULL;SendTemperature,24,128,SendTemperatureDataTask,Default,NULL,Dynamic,NULL,NULL
FREERTOS.configUSE_NEWLIB_REENTRANT=1
Mcu.Family=STM32H7
Mcu.Name=STM32H750VBTx
Mcu.Package=LQFP100
NVIC.PriorityGroup=NVIC_PRIORITYGROUP_4
NVIC.TIM5_IRQn=true\:15\:0\:false\:false\:true\:false\:false\:true\:true
NVIC.TimeBase=TIM5_IRQn
NVIC.TimeBaseIP=TIM5
PB11.GPIO_PuPd=GPIO_PULLUP
PB11.Signal=GPIO_Output
ProjectManager.HeapSize=0x200
ProjectManager.StackSize=0x400
ProjectManager.TargetToolchain=STM32CubeIDE
RCC.ADCFreq_Value=129000000
RCC.APB1Freq_Value=64000000
RCC.APB2Freq_Value=64000000
RCC.APB3Freq_Value=64000000
RCC.APB4Freq_Value=64000000
RCC.CortexFreq_Value=64000000
RCC.HCLKFreq_Value=64000000
RCC.SYSCLKFreq_VALUE=64000000
RCC.USBFreq_Value=129000000
VP_FREERTOS_VS_CMSIS_V2.Mode=CMSIS_V2
VP_MEMORYMAP_VS_MEMORYMAP.Mode=CurAppReg
VP_SYS_VS_tim5.Mode=TIM5
board=custom

// file: Core/Src/main.c
/* USER CODE BEGIN Header */
/**
  ******************************************************************************
  * @file           : main.c
  * @brief          : Main program body
  ******************************************************************************
  * @attention
  *
  * Copyright (c) 2026 STMicroelectronics.
  * All rights reserved.
  *
  * This software is licensed under terms that can be found in the LICENSE file
  * in the root directory of this software component.
  * If no LICENSE file comes with this software, it is provided AS-IS.
  *
  ******************************************************************************
  */
/* USER CODE END Header */
#include "main.h"
#include "FreeRTOS.h"
#include "cmsis_os2.h"

/* USER CODE BEGIN PD */
#define DHT_MODULE_GPIO_PORT 		(GPIOB)
#define DHT_MODULE_GPIO_PIN 		(11)
/* USER CODE END PD */

/* Definitions for ReadSensor */
osThreadId_t ReadSensorHandle;
const osThreadAttr_t ReadSensor_attributes = {
  .name = "ReadSensor",
  .stack_size = 128 * 4,
  .priority = (osPriority_t) osPriorityNormal,
};
/* Definitions for SendTemperature */
osThreadId_t SendTemperatureHandle;
const osThreadAttr_t SendTemperature_attributes = {
  .name = "SendTemperature",
  .stack_size = 128 * 4,
  .priority = (osPriority_t) osPriorityNormal,
};
/* Definitions for TemperatureQueue */
osMessageQueueId_t TemperatureQueueHandle;
const osMessageQueueAttr_t TemperatureQueue_attributes = {
  .name = "TemperatureQueue"
};
/* USER CODE BEGIN PV */

void DHT11_SetPinOutput(void) {

	GPIO_InitTypeDef GPIO_InitStruct;
	GPIO_InitStruct.Pin = DHT_MODULE_GPIO_PIN;
	GPIO_InitStruct.Mode = GPIO_MODE_OUTPUT_PP;
	GPIO_InitStruct.Pull = GPIO_PULLUP;
	GPIO_InitStruct.Speed = GPIO_SPEED_FREQ_LOW;

	HAL_GPIO_Init(DHT_MODULE_GPIO_PORT, &GPIO_InitStruct);
}

void DHT11_SetPinInput(void) {
	__HAL_RCC_GPIOB_CLK_ENABLE();

	GPIO_InitTypeDef GPIO_InitStruct;
	GPIO_InitStruct.Pin = DHT_MODULE_GPIO_PIN;
	GPIO_InitStruct.Mode = GPIO_MODE_INPUT;
	GPIO_InitStruct.Pull = GPIO_PULLUP;
	GPIO_InitStruct.Speed = GPIO_SPEED_FREQ_LOW;

	HAL_GPIO_Init(DHT_MODULE_GPIO_PORT, &GPIO_InitStruct);
}

void DHT11ModuleStart(void) {
	DHT11_SetPinOutput();

	HAL_GPIO_WritePin(DHT_MODULE_GPIO_PORT, DHT_MODULE_GPIO_PIN, 0);
	osDelay(18000);

	DHT11_SetPinInput();
}

uint8_t DHT11ModuleReceive(void) {
	uint8_t recv = 0;
	osDelay(40);

	if (!(HAL_GPIO_ReadPin(DHT_MODULE_GPIO_PORT, DHT_MODULE_GPIO_PIN))) {
		osDelay(80);
		if (HAL_GPIO_ReadPin(DHT_MODULE_GPIO_PORT, DHT_MODULE_GPIO_PIN)) {
			recv = 1;
		}else {
			recv = -1;
		}
	}

	while ((HAL_GPIO_ReadPin(DHT_MODULE_GPIO_PORT, DHT_MODULE_GPIO_PIN)));

	return recv;
}

uint8_t DHT11ModuleRead(void) {
	uint8_t i, j;
	for (j = 0; j<8; j++) {
		while (!(HAL_GPIO_ReadPin(DHT_MODULE_GPIO_PORT, DHT_MODULE_GPIO_PIN)));
		osDelay(40);
		if (!(HAL_GPIO_ReadPin(DHT_MODULE_GPIO_PORT, DHT_MODULE_GPIO_PIN))) {
			i &= ~(1 << (7 - j));
		}
		else {
			i |= (1 << (7 - j));
		}
		while ((HAL_GPIO_ReadPin(DHT_MODULE_GPIO_PORT, DHT_MODULE_GPIO_PIN)));
	}

	return i;
}

/* USER CODE END PV */

void SystemClock_Config(void);
static void MPU_Config(void);
static void MX_GPIO_Init(void);
void ReadSensorTask(void *argument);
void SendTemperatureDataTask(void *argument);

int main(void)
{

  /* MPU Configuration--------------------------------------------------------*/
  MPU_Config();

  /* MCU Configuration--------------------------------------------------------*/

  /* Reset of all peripherals, Initializes the Flash interface and the Systick. */
  HAL_Init();

  /* Configure the system clock */
  SystemClock_Config();

  /* Initialize all configured peripherals */
  MX_GPIO_Init();

  /* Init scheduler */
  osKernelInitialize();

  /* Create the queue(s) */
  /* creation of TemperatureQueue */
  TemperatureQueueHandle = osMessageQueueNew (8, sizeof(uint8_t), &TemperatureQueue_attributes);

  /* Create the thread(s) */
  /* creation of ReadSensor */
  ReadSensorHandle = osThreadNew(ReadSensorTask, NULL, &ReadSensor_attributes);

  /* creation of SendTemperature */
  SendTemperatureHandle = osThreadNew(SendTemperatureDataTask, NULL, &SendTemperature_attributes);

  /* Start scheduler */
  osKernelStart();

  /* We should never get here as control is now taken by the scheduler */

  /* Infinite loop */
  while (1)
  {

  }
}

void SystemClock_Config(void)
{
  RCC_OscInitTypeDef RCC_OscInitStruct = {0};
  RCC_ClkInitTypeDef RCC_ClkInitStruct = {0};

  /** Supply configuration update enable
  */
  HAL_PWREx_ConfigSupply(PWR_LDO_SUPPLY);

  /** Configure the main internal regulator output voltage
  */
  __HAL_PWR_VOLTAGESCALING_CONFIG(PWR_REGULATOR_VOLTAGE_SCALE3);

  while(!__HAL_PWR_GET_FLAG(PWR_FLAG_VOSRDY)) {}

  /** Initializes the RCC Oscillators according to the specified parameters
  * in the RCC_OscInitTypeDef structure.
  */
  RCC_OscInitStruct.OscillatorType = RCC_OSCILLATORTYPE_HSI;
  RCC_OscInitStruct.HSIState = RCC_HSI_DIV1;
  RCC_OscInitStruct.HSICalibrationValue = RCC_HSICALIBRATION_DEFAULT;
  RCC_OscInitStruct.PLL.PLLState = RCC_PLL_NONE;
  if (HAL_RCC_OscConfig(&RCC_OscInitStruct) != HAL_OK)
  {
    Error_Handler();
  }

  /** Initializes the CPU, AHB and APB buses clocks
  */
  RCC_ClkInitStruct.ClockType = RCC_CLOCKTYPE_HCLK|RCC_CLOCKTYPE_SYSCLK
                              |RCC_CLOCKTYPE_PCLK1|RCC_CLOCKTYPE_PCLK2
                              |RCC_CLOCKTYPE_D3PCLK1|RCC_CLOCKTYPE_D1PCLK1;
  RCC_ClkInitStruct.SYSCLKSource = RCC_SYSCLKSOURCE_HSI;
  RCC_ClkInitStruct.SYSCLKDivider = RCC_SYSCLK_DIV1;
  RCC_ClkInitStruct.AHBCLKDivider = RCC_HCLK_DIV1;
  RCC_ClkInitStruct.APB3CLKDivider = RCC_APB3_DIV1;
  RCC_ClkInitStruct.APB1CLKDivider = RCC_APB1_DIV1;
  RCC_ClkInitStruct.APB2CLKDivider = RCC_APB2_DIV1;
  RCC_ClkInitStruct.APB4CLKDivider = RCC_APB4_DIV1;

  if (HAL_RCC_ClockConfig(&RCC_ClkInitStruct, FLASH_LATENCY_1) != HAL_OK)
  {
    Error_Handler();
  }
}

static void MX_GPIO_Init(void)
{
  GPIO_InitTypeDef GPIO_InitStruct = {0};

  /* GPIO Ports Clock Enable */
  __HAL_RCC_GPIOB_CLK_ENABLE();

  /*Configure GPIO pin Output Level */
  HAL_GPIO_WritePin(GPIOB, GPIO_PIN_11, GPIO_PIN_RESET);

  /*Configure GPIO pin : PB11 */
  GPIO_InitStruct.Pin = GPIO_PIN_11;
  GPIO_InitStruct.Mode = GPIO_MODE_OUTPUT_PP;
  GPIO_InitStruct.Pull = GPIO_PULLUP;
  GPIO_InitStruct.Speed = GPIO_SPEED_FREQ_LOW;
  HAL_GPIO_Init(GPIOB, &GPIO_InitStruct);

}

void ReadSensorTask(void *argument)
{
  /* USER CODE BEGIN 5 */
	uint8_t recv;
	uint8_t rh_byte1;
	uint8_t rh_byte2;
	uint8_t tmp_byte1;
	uint8_t tmp_byte2;
	uint8_t sum;
	uint8_t tmp;
	uint8_t rh;

	float temperature;
	float humidity;
  /* Infinite loop */
  for(;;)
  {
	  DHT11ModuleStart();
	  recv = DHT11ModuleReceive();
	  rh_byte1 = DHT11ModuleRead();
	  rh_byte2 = DHT11ModuleRead();
	  tmp_byte1 = DHT11ModuleRead();
	  tmp_byte2 = DHT11ModuleRead();
	  sum = DHT11ModuleRead();

	  tmp = tmp_byte1;
	  rh = rh_byte1;

	  temperature = (float) tmp;
	  humidity = (float) rh;

	  osMessageQueueGet(TemperatureQueueHandle, &temperature, 0, osWaitForever);

	  osDelay(3000);
  }
  /* USER CODE END 5 */
}

void SendTemperatureDataTask(void *argument)
{
  /* USER CODE BEGIN SendTemperatureDataTask */
	uint8_t temperature;
  /* Infinite loop */
  for(;;)
  {
	  osMessageQueueGet(TemperatureQueueHandle, &temperature, 0, osWaitForever);
	  osDelay(1);
  }
  /* USER CODE END SendTemperatureDataTask */
}

 /* MPU Configuration */

void MPU_Config(void)
{
  MPU_Region_InitTypeDef MPU_InitStruct = {0};

  /* Disables the MPU */
  HAL_MPU_Disable();

  /** Initializes and configures the Region and the memory to be protected
  */
  MPU_InitStruct.Enable = MPU_REGION_ENABLE;
  MPU_InitStruct.Number = MPU_REGION_NUMBER0;
  MPU_InitStruct.BaseAddress = 0x0;
  MPU_InitStruct.Size = MPU_REGION_SIZE_4GB;
  MPU_InitStruct.SubRegionDisable = 0x87;
  MPU_InitStruct.TypeExtField = MPU_TEX_LEVEL0;
  MPU_InitStruct.AccessPermission = MPU_REGION_NO_ACCESS;
  MPU_InitStruct.DisableExec = MPU_INSTRUCTION_ACCESS_DISABLE;
  MPU_InitStruct.IsShareable = MPU_ACCESS_SHAREABLE;
  MPU_InitStruct.IsCacheable = MPU_ACCESS_NOT_CACHEABLE;
  MPU_InitStruct.IsBufferable = MPU_ACCESS_NOT_BUFFERABLE;

  HAL_MPU_ConfigRegion(&MPU_InitStruct);
  /* Enables the MPU */
  HAL_MPU_Enable(MPU_PRIVILEGED_DEFAULT);

}

void HAL_TIM_PeriodElapsedCallback(TIM_HandleTypeDef *htim)
{
  if (htim->Instance == TIM5)
  {
    HAL_IncTick();
  }
}

void Error_Handler(void)
{
  __disable_irq();
  while (1)
  {
  }
}
